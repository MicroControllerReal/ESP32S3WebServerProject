/* If you need to add additional file systems to file manager (such as the deprecated SPIFFS or a PSRAM drive, etc.)
 * you will need to add them into the test below (right after #if(UseFileManager)
 * and the definition of fmFS[], and function fsBytes();
 */

#if(UseFileManager)

#if(!(SDType == TypeSD || SDType == TypeMMC || UseLittleFS))
  #error No File System Available for File Manager Use         // If neither SD nor LittleFS is being used, you will get compile errors
#endif                                                         // trying to use the File Manager!

// Variables used in File Manager to get the proper file system(s) (LittleFS, SD)
typedef struct {char name[10]; FS fileSys;} FMfsElem;          // A structure to hold a name and a file system such as SD or LittleFS

FMfsElem fmFS[] = {                                            // Array fmFS holds all available file systems
  #if((SDType == TypeSD || SDType == TypeMMC))
    {"SD", SD}                                                 // Such as SD (for SD or MMC cards)
    #if(UseLittleFS)
      ,
    #endif
  #endif
  #if(UseLittleFS)
    {"LittleFS", LittleFS}                                     // And/Or LittleFS
  #endif
};

const int numFS = sizeof(fmFS) / sizeof(FMfsElem);

#if embedFileman
  // Embedded, gzipped version of fileman.htm allows easy initial uploading of files to mass storage
  // Note that if embedFileman is true, the FilAdminHTM setting in customize.h will be ignored!
  const uint8_t fileman_htm_gz[] PROGMEM = {
  0x1F,0x8B,0x08,0x08,0xB6,0x91,0xCB,0x66,0x04,0x00,0x66,0x69,0x6C,0x65,0x6D,0x61,0x6E,0x2E,0x68,0x74,
  0x6D,0x00,0xB5,0x19,0x5D,0x6F,0xDB,0x36,0xF0,0x7D,0xC0,0xFE,0x83,0xCB,0x61,0xAD,0x34,0x2B,0xFE,0x48,
  0xD6,0x6E,0xB3,0x2C,0x03,0x4B,0xD2,0x60,0x19,0xD6,0xA6,0x58,0x52,0x0C,0x43,0xDB,0x07,0x59,0xA2,0x6D,
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  0x47,0xD9,0xFF,0x00,0x59,0xD9,0xAF,0xA3,0xAA,0x1D,0x00,0x00
};
#endif   // embedFileman

void setupFileManager(){                  // Initialize the file manager service
  server.on("/fileman", HTTP_GET, [](AsyncWebServerRequest *request){
    if(adminAllowed(request)){
#if embedFileman
      // Note that if embedFileman is true, the FilAdminHTM setting in customize.h will be ignored!
      AsyncWebServerResponse *response = request->beginResponse_P(200, "text/html", fileman_htm_gz, sizeof(fileman_htm_gz));
      response->addHeader("Content-Encoding", "gzip");
      request->send(response);
#else
      responseWithCaching(request, FilAdminHTM);
#endif
    }
  });
  server.on("/download", HTTP_GET, [](AsyncWebServerRequest *request){    // /download is virtual. No download.htm
    if(adminAllowed(request)){
      char fsName[12];
      char fPath[256];
      char fName[256];
      int fsNum;
      bool valid;
      getParams(request,false,fsName,fPath,fName,fsNum,valid);
      if(valid){
        char filePathName[500];
        sprintf(filePathName,"%s/%s",fPath,fName);
        AsyncWebServerResponse *response = request->beginResponse(fmFS[fsNum].fileSys, filePathName, String(), true);
        response->addHeader("Server",hostname);
        request->send(response);
      }
    }
  });
  server.on("/upload", HTTP_POST, [](AsyncWebServerRequest *request){     // upload is virtual. no upload.htm
    request->send(200);
  }, handleUpload);
}

void handleUpload(AsyncWebServerRequest *request, String filename, size_t index, uint8_t *data, size_t len, bool final){
  if(adminAllowed(request)){
    char fsName[12];                                                      // Get the name of the file system (SD, LittleFS, ...)
    char fPath[256];                                                      // Get the directory to put this file in
    char fName[256];                                                      // Get the name of this file
    int fsNum;                                                            // Index of fsName within fmFS array
    bool valid;                                                           // Indicates if the complete path is valid
    getParams(request,true,fsName,fPath,fName,fsNum,valid);               // Get request parameters into local variables and test them
    filename.toCharArray(fName, 256);                                     // /upload doesn't have a valid fname parameter, the filename is in the filename parameter of the request
    if(valid){
      char filePathName[256];                                             // Full path and filename
      buildname(filePathName,fsName, fPath, fName, false);
      char UpdateName[275];                                               // Filesystem, path and filename (for tracking uploads)
      buildname(UpdateName,fsName, fPath, fName, true);
      if(!index){                                                         // If index (position) = 0, then first call.
        request->_tempFile = fmFS[fsNum].fileSys.open(filePathName, "w"); // Open a file and embed it within the request.
        updateUpload(UpdateName, 0, false);                               // Update with 0 bytes and not final (stat = 2/open)
      }
      if(len){                                                            // If len > 0, data is available
        request->_tempFile.write(data, len);                              // Write it into the file contained in the request
      }
      if(final){                                                          // If this is the last block
        request->_tempFile.close();                                       // close the file
      }
      updateUpload(UpdateName, index + len, final);                       // Update with total bytes and if final or not (stat = 3/writing or 4/closed)
    }
  }
}

void buildname(char filePathName[], char fsName[], char fPath[], char filename[], bool fs){
  filePathName[0] = 0;
  if(fs){strcat(filePathName, fsName);}
  strcat(filePathName,fPath);
  if(strlen(fPath) > 1){strcat(filePathName,"/");}
  strcat(filePathName,filename);
}

void getParams(AsyncWebServerRequest *request, bool post, char fsName[], char fPath[], char fName[], int &fsNum, bool &valid){
    strcpy(fsName, "");                                                      // Default file system name (for when no parameter is given)
    fsNum=-1;                                                                // File System Number, -1 means not valid
    if(request->hasParam("fs",post,false)){                                  // If a fsSel parameter was given,
      strcpy(fsName, request->getParam("fs",post,false)->value().c_str());   // set the parameter as the file system name to use
      fsNum = getFMfsNum(fsName);                                            // Find this fsName within the fmFS array
      if(fsNum<0)strcpy(fsName, "");                                         // Delete the name if it isn't valid
    }
    strcpy(fPath,"");                                                        // Default path (for when no parameter is given)
    if(request->hasParam("dir",post,false)){                                 // If a path parameter was given
      strcpy(fPath, request->getParam("dir",post,false)->value().c_str());   // get the parameter in a temporary variable
    }
    strcpy(fName,"");                                                        // Default file name (for when no parater is given)
    if(request->hasParam("fname",post,false)){                               // If a file name parameter was given
      strcpy(fName, request->getParam("fname",post,false)->value().c_str()); // get the parameter in a temporary variable
    }
    valid = (fsNum >= 0) && (fPath[0]) && (post || fName[0]);                // Valid only if fsName was found and fPath and fName were provided
    valid &= (!blockedPath(fPath));
}

// Called once when File Manager webpage initializes.
// Builds a websocket response that provides static information: Hostname and a list of available File Systems
void FMgetBasic(char rsvp[]){
  char buff[100];
  strcpy(rsvp,"{\"answer\":\"FMgetBasic\",\"hostname\":\"");
  strcat(rsvp,hostname);
  strcat(rsvp,"\",\"filesys\":[");
  for(int i = 0; i < numFS; i++){
    sprintf(buff,"\"%s\"%s",fmFS[i].name, i==numFS-1 ? "" : ",");
    strcat(rsvp,buff);
  }
  strcat(rsvp,"]}");
}

// Called when a File System is selected. Provides capacity, used, and free bytes
void FMgetFS(char rsvp[], const char* filesys){
  char pattern[] = "\"capacity\":\"%s\",\"used\":\"%s\",\"free\":\"%s\"}";
  char entry[100];
  sprintf(rsvp,"{\"answer\":\"FMgetFS\",\"filesys\":\"%s\",",filesys);
  char capa[12];
  char used[12];
  char free[12];
  int fsNum = getFMfsNum((char*)filesys);
  if(fsNum>=0){
    bytes(capa, fsBytes(fmFS[fsNum].name,1));
    bytes(used, fsBytes(fmFS[fsNum].name,2));
    bytes(free, fsBytes(fmFS[fsNum].name,3));
    sprintf(entry,pattern,
      capa,                           // Total capacity of file system in human convenient form (15.12GB, etc.)
      used,                           // Bytes used on file system in human convenient form (127.12MB, etc.)
      free);                          // Bytes free on file system in human convenient form (15GB, etc.)
    strcat(rsvp, entry);              // Add this file system entry into the String FSInfo
  } else {rsvp[0]=0;}                 // Remove data if file system was not valid
}

int getFMfsNum(char filesys[]){
  int retVal = -1;
  for(int i = 0; i<numFS; i++){
    if(strcmp(fmFS[i].name, filesys)==0){
     retVal = i;
     break;
    }
  }
  return retVal;  
}
void bytes(char buff[], uint64_t b){
  const uint64_t k = 1024;                              // one kilo (as applies to bytes!)
  uint64_t c = 1024;                                    // Comparator
  float d = 1.0;                                        // Divisor
  char label[5][3] = {"B","KB","MB","GB","TB"};
  for(int i = 0; i < 5; i++){
    if(b < c){
      sprintf(buff, "%.2f", ((float)b / d));            // Fill buff with number with two decimals
      while(strlen(buff)>1 &&
      (buff[strlen(buff)-1] == '0' || 
       buff[strlen(buff)-1] == '.')){
        buff[strlen(buff)-1]=0;                         // Remove trailing zeros or decimal points
      }
      strcat(buff,label[i]);                            // Add the designator in (B, KB, etc.)
      break;
    }
    c *= k;
    d *= k;
  }
}

// Can't get byte sizes from a file system, must be explicitly a super class of file system like SD or LitteFS
// So, this helper routine (aka. code cludge!) gets byte information from a file system name like "SD" or "LittleFS"
uint64_t fsBytes(char fsName[],int x){
  uint64_t bytes;
#if(UseLittleFS)
  if(strcmp(fsName,"LittleFS") == 0){
    switch(x){
      case 1: bytes = LittleFS.totalBytes(); break; 
      case 2: bytes = LittleFS.usedBytes(); break; 
      case 3: bytes = LittleFS.totalBytes()-LittleFS.usedBytes(); break; 
    }
    return bytes;
  }
#endif
#if((SDType == TypeSD || SDType == TypeMMC))
  if(strcmp(fsName,"SD") == 0){
    switch(x){
      case 1: bytes = SD.totalBytes(); break; 
      case 2: bytes = SD.usedBytes(); break; 
      case 3: bytes = SD.totalBytes()-SD.usedBytes(); break; 
    }
    return bytes;
  }
#endif
  return 0;
}

bool blockedPath(char path[]){
  if(strlen(FMblockedPath)==0) return false;
  String Dir  = path;
  Dir.concat("/");
  Dir.replace("//","/");
  bool block = Dir.startsWith(FMblockedPath);
  return block;
}

// Called when a directory is selected in File Manager
// Provides a list of directories and a list of files in the path
// The String can get very large if there are lots of directories or files and especially when using long file names!
String FMgetDir(const char* filesys, const char* dir){
  int fs = -1;
  char buff[400];                                    // Buffer to put single directory entries in JSON format into
  if(blockedPath((char *)dir)) return "";
  for(int i = 0; i < numFS; i++){                    // Find the right file System
    if(strcmp(fmFS[i].name, filesys)==0){
      fs = i;
      break;
    }
  }
  if(fs==-1) return "";

  File root = fmFS[fs].fileSys.open(dir);            // Try to open the requested directory using the requested file system.
                                                     // (May not be root, but some path. For our purposes, it is the beginning, so... root)
  if(!root) return "";
  String json = "";
  String paths = "";                                 // String to contain JSON... May be EXTREMELY long if lots of directories and/or deep paths
  char buffB[12];                                    // Buffer to contain file sizes
  sprintf(buff, "{\"answer\":\"FMgetDir\",\"filesys\":\"%s\",\"dir\":\"%s\",\"dirs\":[",filesys,dir);
  paths += buff;
  File file = root.openNextFile();                   // file to use to loop through the path looking for directories
  // First pass through directory collects only directory data.
  // Making two passes may seem inefficient but I am hoping to fragment memory less by
  // not growing two potentially very large strings simultaneously.
  char header[2] = {0,0};
  while(file){                                       // As long as files (or directories) keep coming
    if(file.isDirectory()){
      if(!strcmp(file.name(), "System Volume Information")==0){
        sprintf(buff,"%s/%s", dir, file.name());
        if(!blockedPath(buff)){
          sprintf(buff, "%s\"%s\"",header,file.name());
          paths += buff;
          header[0]=',';                        // Future data elements will be prefaced with ","
        }
      }
    }
    file = root.openNextFile();
  }
  json += paths + "],\"files\":[";
  paths = "";
  root.rewindDirectory();
  header[0] = 0;
  file = root.openNextFile();                   // file to use to loop through the path looking for directories
  // Second pass through directory collects only file data.
  while(file){                                  // As long as files (or directories) keep coming
    if(!file.isDirectory()){
      bytes(buffB,file.size());                 // Format the file size into buffB (1.18KB or 2.34MB or 1.01GB for example)
      char dt[20];                              // buffer for date/time file was last written to
      time_t t = file.getLastWrite();           // Date/Time the file was last written to
      strftime(dt, 20, "%Y/%m/%d %H:%M:%S", localtime(&t));
      sprintf(buff, "%s{\"file\":\"%s\",\"date\":\"%s\",\"size\":\"%s\",\"bytes\":\"%d\"}",header,file.name(),dt,buffB,file.size());
      header[0]=',';
      paths += buff;
    }
    file = root.openNextFile();
  }
  json += paths + "]}";
  return json;
}

String getFilesInfo(char fsName[], char path[]){
  if(fsName =="" || path == "") return "";
  int fs = -1;
  for(int i = 0; i < numFS; i++){
    if(fmFS[i].name == fsName){
      fs = i;
      break;
    }
  }
  if(fs==-1) return "";
  File root = fmFS[fs].fileSys.open(path);           // Try to open the requested directory using the requested file system.
                                                     // (May not be root, but some path. For our purposes, it is the beginning, so... root)
  if(!root) return "";
  String files = "{";                                // String to contail all file entries... May be EXTREMELY long if lots of files and/or long file names
  char buff[300];                                    // Buffer to put file entries in JSON format into
  File file = root.openNextFile();                   // file to use to loop through the path looking for directories
  char header[2] = {0,0};
  char buffB[12];
  while(file){                                       // As long as files (or directories) keep coming
    if(!file.isDirectory()){
      bytes(buffB,file.size());
      sprintf(buff, "%s{\"file\",\"%s\";\"size\":\"%s\"}",header,file.name(),buffB);
      header[0]=',';
      files += buff;
    }
    file = root.openNextFile();
  }
  files += "}";                                        // Add closing brace
}

void FMdelete(int fsNum, char fullPath[]){             // Delete a file as requested by file manager websocket request
  if(!blockedPath(fullPath)){
    if(fsNum >= 0)
      fmFS[fsNum].fileSys.remove(fullPath);
  }
}

void FMmkDir(int fsNum, const char *path, const char *newDir){
  if(fsNum >= 0){
    if(fmFS[fsNum].fileSys.exists(path)){
      char buff[400];
      sprintf(buff,"%s/%s",path,newDir);
      if((!blockedPath(buff)) && (!fmFS[fsNum].fileSys.exists(buff)))
        fmFS[fsNum].fileSys.mkdir(buff);
    }
  }
}

// Variables used in File Manager to keep track of uploads in progress.
// This is done because there is normally no way for the server to tell the client
// how far the upload has progressed, and the client also has no way of knowing how far
// it has progressed. If we had PHP we could do it, but we don't, so...
// we use websocket messages
// Structure  FMupload has data to keep track of uploads in progress
typedef struct {char path[256];                        // Unique. You can't upload the same file more than once simultaneously!
                int stat;                              // 0=Empty, 1=Initializing, 2=Open, 3=Writing/Uploading, 4=Closed
                unsigned long filesize;                // Size of the file as reported by the client
                unsigned long written;                 // Bytes written to the file thus far (index + len)
                unsigned long started;                 // millis() when transfer began
                unsigned long stopped;                  // millis() when transfer finished
               } FMupload;

// Array FMuploads can hold up to 5 active uploads. If we actually had 5 simultaneously, the server
// would definitely be under STRESS
FMupload FMuploads[]={{"",0,0,0},{"",0,0,0},{"",0,0,0},{"",0,0,0},{"",0,0,0}};
const int numFMuploads = sizeof(FMuploads) / sizeof(FMupload);

bool findUpload(char path[], int &w, int &e, bool shortcut){ // Each path is (should be!) unique, find this one
  int i;
  bool found = false;                                   // It has not been found yet
  e = -1;                                               // Haven't found an empty slot yet
  for(i = 0; i<numFMuploads; i++){                      // Loop through all entries in the FMuploads array
    if(FMuploads[i].stat > 0){                          // If this slot contains an entry
      if(strcmp(path, FMuploads[i].path)==0){           // Is it the one we are looking for
        found=true;
        break;
      }
    }
    else if(e==-1){e=i;if(shortcut)break;}              // If this is the first empty slot, remember it
  }
  w = found ? i : e;                                    // Tell the caller where (if) the entry was found or an empty slot is available
  return found;
}

int createUpload(char path[], unsigned long sz){       // Creata an entry in the FMuploads array
  int here=-1, firstEmpty;                             // Variables for where this entry is in array, or first available empty slot
  if(findUpload(path, here, firstEmpty, true) < 0){    // Each path is (should be!) unique, find this one
    if(firstEmpty>=0) here=firstEmpty;                 // If not found (shouldn't), use the first empty slot
  }
  if(here == -1){                                      // If no empty slot is available for creation 
    unsigned long oldest = 0;                          // find the oldest closed slot available and use it
    for(int i = 0; i<numFMuploads; i++){               // Loop through all entries in the FMuploads array
      if(FMuploads[i].stat == 4){                      // If this slot contains an entry that is closed
        if(millis() - FMuploads[i].stopped > oldest){  // Is it older than what we have found so far?
          oldest = millis() - FMuploads[i].stopped;    // Remember how old it is for further comparisons
          here = i;
        }
      }
    }
  }
  if(here>=0){                                         // If the path was found, or an empty slot was available
    strcpy(FMuploads[here].path, path);                // Copy this path into the upload structure
    FMuploads[here].stat = 1;                          // Set the status to 1/Initializing
    FMuploads[here].filesize = sz;                     // Set the expected filesize
    FMuploads[here].written = 0;                       // So far, zero bytes have been written
    FMuploads[here].started = 0;                       // It hasn't started
    FMuploads[here].stopped = 0;                       // It hasn't stopped
  }
  return here;
}

int updateUpload(char path[], unsigned long bytes, bool final){  // Update this entry in the FMuploads array
  int here=-1, firstEmpty;                                 // Variables for where this entry is in array, or first available empty slot
  findUpload(path, here, firstEmpty,false);             // Each path is (should be!) unique, find this one
  if(here>=0){                                          // If the path was found
    if(bytes == 0){
      FMuploads[here].stat = 2;                         // Set status to 2/Open
      FMuploads[here].started = millis();               // Record time when download began
    } else FMuploads[here].stat = final ? 4 : 3;        // Set status to 4/Closed or 3/Writing
    FMuploads[here].written = bytes;
    if(final)FMuploads[here].stopped = millis();        // Record time when download was completed
  }
  return here;
}

void deleteUpload(char path[]){                         // Delete this entry from FMuploads array
  int here, firstEmpty;                                 // Variables for where this entry is in array, or first available empty slot
  findUpload(path, here, firstEmpty, false);            // Each path is (should be!) unique, find this one
  if(here>=0){                                          // If the path was found
    FMuploads[here].path[0] = 0;                        // Delete the path in the upload structure
    FMuploads[here].stat = 0;                           // Reset the status to 0/Empty
    FMuploads[here].filesize = 0;                       // Reset the expected filesize to 0
    FMuploads[here].written = 0;                        // Reset bytes written to 0
  }
}

void statusUpload(char path[], char stat[]){            // Build up a websocket response to a request for upload status
  int here, firstEmpty;                                 // Variables for where this entry is in array, or first available empty slot
  findUpload(path, here, firstEmpty, false);            // Each path is (should be!) unique, find this one
  strcpy(stat,"");                                      // Start with a clean buffer
  if(here>=0){                                          // If the path was found
    unsigned long pct = 0;
    if(FMuploads[here].stat > 2){                       // Only calculate a percentage of completion if at least writing
      if(FMuploads[here].filesize > 0){                 // Can't divide by zero, but filesizes can be zero. Avoid division by zero error!
        float f = ((float) FMuploads[here].written) / ((float) FMuploads[here].filesize);
        f *= 100.0;
        pct = f;
      } else pct = 100;                                 // Files with zero length are 100% transferred.
    }
    unsigned long t = (FMuploads[here].stat == 4 ? FMuploads[here].stopped : millis()) - FMuploads[here].started;
    sprintf(stat,"{\"answer\":\"FMuploadStatus\",\"bytes\":\"%u\",\"size\":\"%u\",\"percent\":\"%u\",\"status\":\"%i\",\"time\":\"%u\"}",
       FMuploads[here].written, FMuploads[here].filesize, pct, FMuploads[here].stat, t);
  }
}
#endif   // useFileManager
